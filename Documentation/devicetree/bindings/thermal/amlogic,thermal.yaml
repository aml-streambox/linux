## Documentation/devicetree/bindings/thermal/amlogic,thermal.yaml
```yaml
# SPDX-License-Identifier: (GPL-2.0 OR BSD-2-Clause)
%YAML 1.2
---
$id: http://devicetree.org/schemas/thermal/amlogic,thermal.yaml#
$schema: http://devicetree.org/meta-schemas/core.yaml#

title: Amlogic Thermal

maintainers:
  - Guillaume La Roque <glaroque@baylibre.com>

description: Binding for Amlogic Thermal

$ref: thermal-sensor.yaml#

properties:
  compatible:
    oneOf:
      - items:
          - enum:
              - amlogic,g12a-cpu-thermal
              - amlogic,g12a-ddr-thermal
          - const: amlogic,g12a-thermal
      - const: amlogic,a1-cpu-thermal
      - const: amlogic,t7-thermal

  reg:
    maxItems: 1

  interrupts:
    maxItems: 1

  clocks:
    maxItems: 1

  power-domains:
    maxItems: 1

  amlogic,ao-secure:
    description: phandle to the ao-secure syscon
    $ref: /schemas/types.yaml#/definitions/phandle

  secure-monitor:
    description: phandle to the secure-monitor firmware node
    $ref: /schemas/types.yaml#/definitions/phandle

  amlogic,thermal-sensor-id:
    description: secure-monitor thermal calibration sensor index
    $ref: /schemas/types.yaml#/definitions/uint32
    minimum: 1
    maximum: 6

  '#thermal-sensor-cells':
    const: 0

required:
  - compatible
  - reg
  - interrupts
  - clocks

allOf:
  - if:
      properties:
        compatible:
          contains:
            const: amlogic,t7-thermal
    then:
      required:
        - secure-monitor
        - amlogic,thermal-sensor-id
    else:
      required:
        - amlogic,ao-secure

unevaluatedProperties: false

examples:
  - |
    temperature-sensor@ff634800 {
        compatible = "amlogic,g12a-cpu-thermal",
                     "amlogic,g12a-thermal";
        reg = <0xff634800 0x50>;
        interrupts = <0x0 0x24 0x0>;
        clocks = <&clk 164>;
        #thermal-sensor-cells = <0>;
        amlogic,ao-secure = <&sec_AO>;
    };
...
```
